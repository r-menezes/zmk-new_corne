#include <input/processors.dtsi>
#include <zephyr/dt-bindings/input/input-event-codes.h>
#include <behaviors.dtsi>
#include <behaviors/num_word.dtsi> // Requires zmk-auto-layer module.
#include <behaviors/unicode.dtsi> // Requires zmk-unicode module.
#include <zmk-unicode/keys-extra.h>  // All glyphs except CJK
#include <dt-bindings/zmk/bt.h>
#include <dt-bindings/zmk/ext_power.h>
#include <dt-bindings/zmk/keys.h>
#include <dt-bindings/zmk/outputs.h>
#define ZMK_POINTING_DEFAULT_SCRL_VAL 40    // default: 10
#include <dt-bindings/zmk/pointing.h>
#include <dt-bindings/zmk/rgb.h>
#define HOST_OS 1
#include "zmk-helpers/helper.h"
#include "zmk-helpers/unicode-chars/portuguese.dtsi"
#include "zmk-helpers/key-labels/eyelash42.h"                                      // Source key-labels
#define KEYS_L LT0 LT1 LT2 LT3 LT4 LT5 LM0 LM1 LM2 LM3 LM4 LM5 LB0 LB1 LB2 LB3 LB4 LB5 // Left-hand keys
#define KEYS_R RT0 RT1 RT2 RT3 RT4 RT5 RM0 RM1 RM2 RM3 RM4 RM5 RB0 RB1 RB2 RB3 RB4 RB5 // Right-hand keys
#define THUMBS LH2 LH1 LH0 RH0 RH1 RH2                                      // Thumb keys

// Layer definitions
#define DEF 0
#define NAV 1
#define FN 2
#define NUM 3
#define SYMB 4
#define BR 5

// better readability
#define XXX &none
#define ___ &trans

// Sticky keys
&sk {
  release-after-ms = <900>;
  quick-release;
};

&uc {
  default-mode = <UC_MODE_LINUX>;  // Replace with desired input system.
};

// Allow sticky mods to chord across sticky layers.
&sl {
  ignore-modifiers;
};

// Hold-tap settings
#define QUICK_TAP_MS 175

// Layer tap behavior
&lt {
  flavor = "balanced";
  tapping-term-ms = <200>;
  quick-tap-ms = <QUICK_TAP_MS>;
};

// HOME ROW MODS
#define MAKE_HRM(NAME, HOLD, TAP, TRIGGER_POS)                                 \
  ZMK_HOLD_TAP(NAME, bindings = <HOLD>, <TAP>; flavor = "balanced";            \
               tapping-term-ms = <280>; quick-tap-ms = <QUICK_TAP_MS>;         \
               require-prior-idle-ms = <150>; hold-trigger-on-release;         \
               hold-trigger-key-positions = <TRIGGER_POS>;)

MAKE_HRM(hml, &kp, &kp, KEYS_R THUMBS) // Left-hand HRMs.
MAKE_HRM(hmr, &kp, &kp, KEYS_L THUMBS) // Right-hand HRMs.
// MAKE_HRM(hml_ak_a, &kp, &ak_a, KEYS_R THUMBS) // Left-hand HRMs for ak_a

// Hack: Make HRM combos tap-only (cf, ZMK issue #544).
#define ZMK_COMBO_8(NAME, TAP, POS, LAYERS, COMBO_MS, IDLE_MS, HOLD, SIDE)     \
  MAKE_HRM(hm_combo_##NAME, &kp, TAP, SIDE THUMBS)                             \
  ZMK_COMBO_6(NAME, &hm_combo_##NAME HOLD 0, POS, LAYERS, COMBO_MS, IDLE_MS)

// Scroll speed and acceleration settings
&msc {
    y-input-code = <INPUT_REL_WHEEL>;
    acceleration-exponent = <1>;      // 0
    time-to-max-speed-ms = <300>;       // 300
    delay-ms = <0>;                   // 0
};

// Mouse movement speed and acceleration settings
&mmv {
    time-to-max-speed-ms = <500>; // 1000
    acceleration-exponent = <1>; // 2
    trigger-period-ms = <16>; // 16
};

// Soft off behavior
// &soft_off { hold-time-ms = <1000>; };

// Sticky shift + leader.
// ZMK_MACRO(leader_sft, bindings = <&sk LSHFT &leader>;)

// Combos, leader key sequences, mouse emulation

#include "combos.dtsi" // Must be sourced after HRM-combo hack.
// #include "leader.dtsi"

/* Nav cluster */

// Trigger tap-action on all interrupts.
#define MT_CORE                                                                \
  flavor = "tap-preferred";                                                    \
  tapping-term-ms = <220>;                                                     \
  quick-tap-ms = <220>;                                                        \
  hold-trigger-key-positions = <0>;

&mt { MT_CORE };

ZMK_HOLD_TAP(mt_home, bindings = <&masked_home>, <&kp>; MT_CORE)
ZMK_HOLD_TAP(mt_end, bindings = <&masked_end>, <&kp>; MT_CORE)

#define NAV_LEFT  &mt_home 0   LEFT  // Tap: left  | Long-tap: start of line.
#define NAV_RIGHT &mt_end 0    RIGHT // Tap: right | Long-tap: end   of line.
#define NAV_UP    &mt LC(HOME) UP    // Tap: up    | Long-tap: start of doc.
#define NAV_DOWN  &mt LC(END)  DOWN  // Tap: down  | Long-tap: end   of doc.
#define NAV_BSPC  &mt LC(BSPC) BSPC  // Tap: bspc  | Long-tap: delete word bwd.
#define NAV_DEL   &mt LC(DEL)  DEL   // Tap: del   | Long-tap: delete word fwd.
#define VOL_DOWN  &hml RSHFT C_VOL_DN

// Mask CTRL on left/right hold to avoid accidental jumps to start/end of doc.
#define MASK_MODS(NAME, MODS, BINDING)                                         \
  ZMK_MOD_MORPH(NAME, bindings = <BINDING>, <BINDING>; mods = <MODS>;)

MASK_MODS(masked_home, (MOD_LCTL), &kp HOME)
MASK_MODS(masked_end,  (MOD_LCTL), &kp END)

/* Magic-shift & auto-layers */

// Tap: repeat after alpha, else sticky-shift |
// Shift + tap/ double-tap: caps-word | Hold: shift.
#define MAGIC_SHIFT &magic_shift LSHFT 0
ZMK_HOLD_TAP(magic_shift, bindings = <&kp>, <&caps_word>;
             flavor = "balanced"; tapping-term-ms = <200>;
             quick-tap-ms = <QUICK_TAP_MS>;)
// ZMK_MOD_MORPH(magic_shift_tap, bindings = <&shift_repeat>, <&caps_word>;
//               mods = <(MOD_LSFT)>;)
// ZMK_ADAPTIVE_KEY(
//     shift_repeat, bindings = <&sk LSHFT>;
//     repeat {
//       trigger-keys = <A B C D E F G H I J K L M N O P Q R S T U V W X Y Z>;
//       bindings = <&key_repeat>;
//       max-prior-idle-ms = <1200>;
//       strict-modifiers;
//     };)
// SIMPLER VERSION OF NOT SO MAGIC SHIFT:
// #define MAGIC_SHIFT &mt LSHFT LSHFT
&caps_word { // Mods deactivate caps-word, requires PR #1451. [TODO: rebase]
  /delete-property/ ignore-modifiers;
};

// Tap: num-word | double-tap: sticky num-layer | Hold: num-layer.
#define SMART_NUM &smart_num NUM 0
ZMK_HOLD_TAP(smart_num, bindings = <&mo>, <&num_dance>; flavor = "balanced";
             tapping-term-ms = <200>; quick-tap-ms = <QUICK_TAP_MS>;)
ZMK_TAP_DANCE(num_dance, bindings = <&num_word NUM>, <&sl NUM>;
              tapping-term-ms = <200>;)

// Tap: backspace | shft + tap: delete.
ZMK_MOD_MORPH(bs_del, bindings = <&kp BSPC>, <&kp DEL>;
              mods = <(MOD_LSFT|MOD_RSFT)>;)

ZMK_MOD_MORPH(tilde_caret, bindings = <&kp TILDE>, <&kp CARET>; mods = <(MOD_LSFT|MOD_RSFT)>;)
ZMK_MOD_MORPH(grave_acute, bindings = <&kp GRAVE>, <&kp APOS>; mods = <(MOD_LSFT|MOD_RSFT)>;)
ZMK_MOD_MORPH(bslh_qmark, bindings = <&kp BSLH>, <&kp QMARK>; mods = <(MOD_LSFT|MOD_RSFT)>;)

// #include "pt_macros.dtsi"

// One-param macro wrappers for pt_* unicode behaviors so they can be used as
// the tap side of a hold-tap (which requires #binding-cells = <2> total).
// The passed param is ignored; the macro simply fires the unicode behavior.
ZMK_MACRO_ONE_PARAM(m_pt_a_tilde,      bindings = <&pt_a_tilde>;)
ZMK_MACRO_ONE_PARAM(m_pt_e_circumflex, bindings = <&pt_e_circumflex>;)
ZMK_MACRO_ONE_PARAM(m_pt_o_circumflex, bindings = <&pt_o_circumflex>;)

// Hold-tap wrappers for the BR layer using the macro wrappers above.
// Usage: &hml_pt_a_tilde LGUI 0  (0 is the ignored tap param)
MAKE_HRM(hml_pt_a_tilde,      &kp, &m_pt_a_tilde,      KEYS_R THUMBS)
MAKE_HRM(hml_pt_e_circumflex, &kp, &m_pt_e_circumflex, KEYS_R THUMBS)
MAKE_HRM(hmr_pt_o_circumflex, &kp, &m_pt_o_circumflex, KEYS_L THUMBS)

// BROKEN!
// Tap: return |  Hold: nav layer.
// #define LT_NAV_RET &lt_ret NAV 0
// ZMK_HOLD_TAP(lt_ret, bindings = <&mo>, <&kp RET>; flavor = "balanced";
//              tapping-term-ms = <200>; quick-tap-ms = <QUICK_TAP_MS>;)
// Tap: space |  Hold: FN layer.
// #define LT_FN_SPC &lt_spc FN 0
// ZMK_HOLD_TAP(lt_spc, bindings = <&mo>, <&kp SPC>; flavor = "balanced";
//              tapping-term-ms = <200>; quick-tap-ms = <QUICK_TAP_MS>;)

/* Keymap */
// ZMK_CONDITIONAL_LAYER(sys, FN NUM, SYS) // FN + NUM --> SYS.

#ifndef ZMK_BASE_LAYER
  #define ZMK_BASE_LAYER(name, LT, RT, LM, RM, LB, RB, LH, RH)                 \
      ZMK_LAYER(name, LT RT LM RM LB RB LH RH)
#endif

// Encoder keys
#define _ENC_L_C_R_KEYS_                                           \
    &kp PG_UP &kp PSCRN &kp PG_DN

#define RGB_CONTROLS                                                  \
    &rgb_ug RGB_BRD &rgb_ug RGB_BRI &rgb_ug RGB_HUD &rgb_ug RGB_HUI &rgb_ug RGB_SAD &rgb_ug RGB_SAI

#define RGB_EF_CONTROLS                                                  \
    &rgb_ug RGB_EFR &rgb_ug RGB_EFF

#define SCRLUP &msc MOVE_Y(16)
#define SCRLDN &msc MOVE_Y(-16)

ZMK_BASE_LAYER(Base,
//╭─────────────┬─────────────┬─────────────┬─────────────┬─────────────┬─────────────╮                 ╭──────╮        ╭─────────────┬─────────────┬─────────────┬─────────────┬─────────────┬─────────────╮
    &kp TAB       &kp Q         &kp W         &kp E         &kp R         &kp T       ,                  &kp UP           &kp Y         &kp U         &kp I         &kp O         &kp P          &bs_del    ,
//├─────────────┼─────────────┼─────────────┼─────────────┼─────────────┼─────────────┤           ╭─────╯      ╰─────╮  ├─────────────┼─────────────┼─────────────┼─────────────┼─────────────┼─────────────┤
    &kp ESC       &hml LGUI A   &hml LALT S   &hml LSHFT D  &hml LCTRL F  &kp G       ,             _ENC_L_C_R_KEYS_      &kp H         &hmr LCTRL J  &hmr LSHFT K  &hmr LALT L   &hmr LGUI SEMI &kp LBKT   ,
//├─────────────┼─────────────┼─────────────┼─────────────┼─────────────┼─────────────┤  ╭─────╮  ╰─────╮      ╭─────╯  ├─────────────┼─────────────┼─────────────┼─────────────┼─────────────┼─────────────┤
    &kp NUBS      &kp Z         &kp X         &kp C         &kp V         &kp B       ,   &kp SPACE     &kp DOWN          &kp N         &kp M         &kp COMMA     &kp DOT       &bslh_qmark    &kp RBKT   ,
//╰─────────────┴─────────────┴─────────────┼─────────────┼─────────────┼─────────────┤  ╰─────╯        ╰──────╯        ├─────────────┼─────────────┼─────────────┼─────────────┴─────────────┴─────────────╯
                                              MAGIC_SHIFT   &mo SYMB     &lt NAV RET ,                                    &lt FN SPACE  SMART_NUM     &mo BR       
//                                          ╰─────────────┴─────────────┴─────────────╯                                 ╰─────────────┴─────────────┴─────────────╯
)

ZMK_BASE_LAYER(Nav,
//╭─────────────┬─────────────┬─────────────┬─────────────┬─────────────┬─────────────╮                ╭─────╮      ╭─────────────┬─────────────┬─────────────┬─────────────┬─────────────┬─────────────╮
    ___           ___           ___           ___           &kp LA(TAB)   ___         ,                  ___          &kp HOME      &kp PG_DN     &kp PG_UP     &kp END       NAV_DEL       NAV_BSPC    ,
//├─────────────┼─────────────┼─────────────┼─────────────┼─────────────┼─────────────┤           ╭────╯     ╰────╮ ├─────────────┼─────────────┼─────────────┼─────────────┼─────────────┼─────────────┤
    ___           &sk LGUI      &sk LALT      &sk LSHFT     &sk LCTRL     ___         ,             ___  ___  ___     NAV_LEFT      NAV_DOWN      NAV_UP        NAV_RIGHT     &kp RET       SCRLUP      ,
//├─────────────┼─────────────┼─────────────┼─────────────┼─────────────┼─────────────┤  ╭─────╮  ╰────╮     ╭────╯ ├─────────────┼─────────────┼─────────────┼─────────────┼─────────────┼─────────────┤
    ___           ___           ___           ___           ___           ___         ,    ___           ___          &kp INS       &kp TAB       ___           ___           &kp K_APP     SCRLDN      ,
//╰─────────────┼─────────────┴─────────────┴─────────────┼─────────────┼─────────────┤  ╰─────╯       ╰─────╯      ├─────────────┼─────────────┼─────────────┼─────────────┴─────────────┴─────────────╯
                                              ___           ___           ___         ,                               ___           ___           ___          
//                                          ╰─────────────┴─────────────┴─────────────╯                             ╰─────────────┴─────────────┴─────────────╯
)

ZMK_BASE_LAYER(Fn,
//╭─────────────┬─────────────┬─────────────┬─────────────┬─────────────┬─────────────╮                ╭─────╮      ╭─────────────┬─────────────┬─────────────┬─────────────┬─────────────┬─────────────╮
    RGB_EF_CONTROLS             &kp C_PREV    &kp C_PP     &kp C_NEXT    &kp C_VOL_UP ,                  ___          &bt BT_NXT   &kp F7        &kp F8        &kp F9        &kp F12       ___         ,
//├─────────────┼─────────────┼─────────────┼─────────────┼─────────────┼─────────────┤           ╭────╯     ╰────╮ ├─────────────┼─────────────┼─────────────┼─────────────┼─────────────┼─────────────┤
    &rgb_ug RGB_TOG   ___       ___           ___           ___          &kp C_VOL_DN ,       ___  &bt BT_CLR  ___    &bt BT_PRV  &hmr RCTRL F4  &hmr RSHFT F5 &hmr LALT F6 &hmr LGUI F10  ___         ,
//├─────────────┼─────────────┼─────────────┼─────────────┼─────────────┼─────────────┤  ╭─────╮  ╰────╮     ╭────╯ ├─────────────┼─────────────┼─────────────┼─────────────┼─────────────┼─────────────┤
    RGB_CONTROLS                                                                      ,    ___           ___          &out OUT_TOG &kp F1        &kp F2        &kp F3        &kp F11       ___         ,
//╰─────────────┴─────────────┴─────────────┼─────────────┼─────────────┼─────────────┤  ╰─────╯       ╰─────╯      ├─────────────┼─────────────┼─────────────┼─────────────┴─────────────┴─────────────╯
                                              &kp CAPS      ___           ___         ,                               ___           ___           ___          
//                                          ╰─────────────┴─────────────┴─────────────╯                             ╰─────────────┴─────────────┴─────────────╯
)

ZMK_BASE_LAYER(Num,
//╭─────────────┬─────────────┬─────────────┬─────────────┬─────────────┬─────────────╮                ╭─────╮      ╭─────────────┬─────────────┬─────────────┬─────────────┬─────────────┬─────────────╮
    ___           &kp PLUS      &kp MINUS     &kp STAR      &kp SLASH     &kp EQUAL   ,                  ___          ___           &kp N7        &kp N8        &kp N9        ___           ___         ,
//├─────────────┼─────────────┼─────────────┼─────────────┼─────────────┼─────────────┤           ╭────╯     ╰────╮ ├─────────────┼─────────────┼─────────────┼─────────────┼─────────────┼─────────────┤
    ___           ___           ___           ___           ___           ___         ,             ___  ___  ___     &kp DOT      &hmr RCTRL N4  &hmr RSHFT N5 &hmr LALT N6  &hmr LGUI N0  ___         ,
//├─────────────┼─────────────┼─────────────┼─────────────┼─────────────┼─────────────┤  ╭─────╮  ╰────╮     ╭────╯ ├─────────────┼─────────────┼─────────────┼─────────────┼─────────────┼─────────────┤
    ___           ___           ___           ___           ___           ___         ,    ___           ___          &kp COMMA     &kp N1        &kp N2        &kp N3        ___           ___         ,
//╰─────────────┴─────────────┴─────────────┼─────────────┼─────────────┼─────────────┤  ╰─────╯       ╰─────╯      ├─────────────┼─────────────┼─────────────┼─────────────┴─────────────┴─────────────╯
                                              ___           ___           ___         ,                               ___          ___            ___          
//                                          ╰─────────────┴─────────────┴─────────────╯                             ╰─────────────┴─────────────┴─────────────╯
)

ZMK_BASE_LAYER(Symbol,
//╭─────────────┬─────────────┬─────────────┬─────────────┬─────────────┬─────────────╮                ╭─────╮      ╭─────────────┬─────────────┬─────────────┬─────────────┬─────────────┬─────────────╮
    &kp APOS      &kp EXCL      &kp AT        &kp HASH      &kp DLLR      &kp PRCNT   ,                  ___          &kp CARET     &kp AMPS      &kp ASTRK     &kp LPAR      &kp RPAR      &kp BSPC    ,
//├─────────────┼─────────────┼─────────────┼─────────────┼─────────────┼─────────────┤           ╭────╯     ╰────╮ ├─────────────┼─────────────┼─────────────┼─────────────┼─────────────┼─────────────┤
    &kp DQT       ___           ___           ___           ___           ___         ,             ___  ___  ___     &kp MINUS     &kp UNDER     &kp LT        &kp GT        &kp LBKT      &kp RBKT    ,
//├─────────────┼─────────────┼─────────────┼─────────────┼─────────────┼─────────────┤  ╭─────╮  ╰────╮     ╭────╯ ├─────────────┼─────────────┼─────────────┼─────────────┼─────────────┼─────────────┤
    ___           &kp PLUS      &kp MINUS     &kp STAR      &kp SLASH     &kp EQUAL   ,    ___           ___          &kp BSLH      &kp PIPE      &kp FSLH      &kp QMARK     &kp LBRC      &kp RBRC    ,
//╰─────────────┴─────────────┴─────────────┼─────────────┼─────────────┼─────────────┤  ╰─────╯       ╰─────╯      ├─────────────┼─────────────┼─────────────┼─────────────┴─────────────┴─────────────╯
                                              ___           ___           ___         ,                               ___           ___           ___          
//                                          ╰─────────────┴─────────────┴─────────────╯                             ╰─────────────┴─────────────┴─────────────╯
)

ZMK_BASE_LAYER(BR,
//╭─────────────┬─────────────┬─────────────┬─────────────┬─────────────┬─────────────╮                ╭─────╮      ╭─────────────┬─────────────┬─────────────┬─────────────┬─────────────┬─────────────╮
    ___           &pt_aa        ___           &pt_e_acute   ___           ___         ,                  ___         ___            &pt_u_acute   &pt_i_acute   &pt_oa        ___           ___         ,
//├─────────────┼─────────────┼─────────────┼─────────────┼─────────────┼─────────────┤           ╭────╯     ╰────╮ ├─────────────┼─────────────┼─────────────┼─────────────┼─────────────┼─────────────┤
    ___           &hml_pt_a_tilde LGUI 0  ___   &hml_pt_e_circumflex LSHFT 0  ___  ___   ,             ___  ___  ___     ___           ___           ___           &hmr_pt_o_circumflex LALT 0  ___  ___    ,
//├─────────────┼─────────────┼─────────────┼─────────────┼─────────────┼─────────────┤  ╭─────╮  ╰────╮     ╭────╯ ├─────────────┼─────────────┼─────────────┼─────────────┼─────────────┼─────────────┤
    &pt_a_grave   &pt_a_circumflex  ___       &pt_c_cedilla  ___          ___         ,    ___           ___          ___           ___           ___           &pt_o_tilde   ___           ___         ,
//╰─────────────┴─────────────┴─────────────┼─────────────┼─────────────┼─────────────┤  ╰─────╯       ╰─────╯      ├─────────────┼─────────────┼─────────────┼─────────────┴─────────────┴─────────────╯
                                              ___           ___           ___         ,                               ___           ___           ___          
//                                          ╰─────────────┴─────────────┴─────────────╯                             ╰─────────────┴─────────────┴─────────────╯
)