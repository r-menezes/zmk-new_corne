## config/west.yml
```yaml
manifest:
  remotes:
    - name: zmkfirmware
      url-base: https://github.com/zmkfirmware
    - name: dsifry # BONGO CAT
      url-base: https://github.com/dsifry
    - name: urob # HOME-ROW MODS AND SEVERAL QOL IMPROVEMENTS
      url-base: https://github.com/urob
    - name: a741725193 # EYELASH CORNE
      url-base: https://github.com/a741725193
  projects:
    - name: eyelash_corne
      url: https://github.com/a741725193/zmk-new_corne
      revision: main
    - name: zmk
      remote: zmkfirmware
      revision: v0.3
      import: app/west.yml
    - name: zmk-helpers # ZMK HELPERS
      remote: urob
      revision: main
      revision: v0.3 # Should match ZMK release.
    - name: zmk-leader-key # LEADER KEY FUNCTIONALITY
      remote: urob
      revision: main
      revision: v0.3 # Should match ZMK release.
    - name: zmk-auto-layer
      remote: urob
      revision: v0.3 # Should match ZMK release.
    - name: nice-view-mod # BONGO CAT
      remote: dsifry
      revision: main
  self:
    path: config
```
